## config/boards/shields/ximi/Kconfig.defconfig
```kconfig
# Copyright (c) 2020 The ZMK Contributors
# SPDX-License-Identifier: MIT

if SHIELD_XIMI

config ZMK_KEYBOARD_NAME
    default "ximi"

config SPI
        default y

config SYSTEM_WORKQUEUE_STACK_SIZE
    default 2048

if ZMK_BACKLIGHT

config LED_GPIO
    default y

endif # ZMK_BACKLIGHT

endif
```

## config/west.yml
```yaml
manifest:
  remotes:
    - name: zmkfirmware
      url-base: https://github.com/zmkfirmware
    - name: sadekbaroudi
      url-base: https://github.com/sadekbaroudi
  projects:
    # - name: zmk
    #   remote: zmkfirmware
    #   revision: main
    #   import: app/west.yml
    - name: zmk
      remote: sadekbaroudi
      revision: rp2040-with-combo-fix
      import: app/west.yml
  self:
    path: config
```
